#include "1202_lib.h"
#include "main.h"

#define sWidth 5

uint8_t lcdMutex = 0;

// 7 bit is end-of-symbol flag. But all symbols are 6 pixel width
const uint8_t font_1[] PROGMEM = {
    0b00000000, 0b00000000, 0b00000000, 0b00000000, 0b00000000, // space
    0b00001110, 0b01011111, 0b00001110, 0b00000000, 0b00000000, // !
    0b00000110, 0b00001110, 0b00000000, 0b00001110, 0b00000110, // "
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    0b01100100, 0b01010100, 0b01010100, 0b01010100, 0b01001100  // z
};
const uint8_t font_2[] PROGMEM = {
    0b01111111, 0b01001001, 0b01001001, 0b01001001, 0b00110001, // Б
    0b01111111, 0b00000001, 0b00000001, 0b00000001, 0b00000001, // Г
    0b01111100, 0b01010101, 0b01010100, 0b01010101, 0b01000100, // Ё
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    0b01001100, 0b01010010, 0b00110010, 0b00010010, 0b01111110  // я
};
const uint8_t font_3[] PROGMEM = {
    0b01100000, 0b00111111, 0b00100001, 0b00111111, 0b01100000, // Д
    0b00111111, 0b00100000, 0b00100000, 0b00111111, 0b01100000, // Ц
    0b00111111, 0b00100000, 0b00111110, 0b00100000, 0b01111111, // Щ
    0b01100000, 0b00111110, 0b00100010, 0b00111110, 0b01100000, // д
    0b00011100, 0b00100010, 0b01111111, 0b00100010, 0b00011100, // ф
    0b00111110, 0b00100000, 0b00100000, 0b00111110, 0b01100000, // ц
    0b00111110, 0b00100000, 0b00111100, 0b00100000, 0b01111110  // щ
};

void lcdInit() {
    // magic sequence of commands performs initialization of LCD
    if (lcdMutex) return;
    lcdMutex = 1;
    LCD_write_byte(0xE2, 0); // reset
    LCD_write_byte(0xA4, 0); // power saver off
    LCD_write_byte(0x2F, 0); // power control set
    LCD_write_byte(0xAF, 0); // LCD display on
    LCD_write_byte(0x20, 0); // V0R
    LCD_write_byte(0xE1, 0); // VOP (contrast)
    LCD_write_byte(0x00, 0);
    LCD_write_byte(0x88, 0); // Electronix volume (user contrast)
    // display rotate :)
    LCD_write_byte(0xA1, 0); // segment driver direction select
    LCD_write_byte(0xC8, 0); // common driver direction select
    lcdMutex = 0;
}

void lcdLocate(uint8_t y, uint8_t x) { // 471 clocks (59us)
    if (lcdMutex) return;
    lcdMutex = 1;
    y &= 0x0F;
    x = (x & 0x0F) * FONT_WIDTH;
    LCD_write_byte(0xB0 | y, 0); // set page address (row)
    LCD_write_byte(x & 0x0F, 0); // set column address lower nibble
    LCD_write_byte(0x10 | ((x >> 4) & 0x07), 0); // set column address higher nibble
    lcdMutex = 0;
}

void lcdGotoXY(uint8_t x, uint8_t y) { // 464 clocks (58us)
    if (lcdMutex) return;
    lcdMutex = 1;
    y &= 0x0F;
    LCD_write_byte(0xB0 | y, 0); // set page address (row)
    LCD_write_byte(x & 0x0F, 0); // set column address lower nibble
    LCD_write_byte(0x10 | ((x >> 4) & 0x07), 0); // set column address higher nibble
    lcdMutex = 0;
}

void lcdPrintChar(unsigned char symbol, tFontStyle style) { // 947 clocks (118us)+
    const uint8_t *start = &font_1[0];
    if (symbol >= 0xE0) {
        start = (&font_3[0]) + (symbol - 0xE0) * sWidth;
    } else if (symbol >= 0xA0) {
        start = (&font_2[0]) + (symbol - 0xA0) * sWidth;
    } else if (symbol >= 0x20) {
        start = (&font_1[0]) + (symbol - 0x20) * sWidth;
    } else return;

    start += -1;
    for (int8_t i = 0; i < sWidth; i++) {
        start += 1;
        uint8_t col = pgm_read_byte(start);
        if (style & invisible) col = 0;
        if (style & inversed) {
            col = ~col;
        }
        LCD_write_byte(col, 1);
    }
    // interletter spacing
    if (style & inversed) {
        LCD_write_byte(0xFF, 1);
    } else {
        LCD_write_byte(0, 1);
    }
}

uint8_t lcdPrint(const progmemchar *message, tFontStyle style) { // 13 + (13 + lcdPrintChar) * length
    unsigned char symbol;
    uint8_t count = 0;
    while ((symbol = pgm_read_byte(message)) != cTerm && LCD_COLUMNS > count++) {
        message += 1;
        lcdPrintChar(symbol, style);
    }
    return count;
}

uint8_t lcdRamPrint(const char *message, tFontStyle style) {
    uint8_t count = 0;
    while (cTerm != *message) {
        lcdPrintChar((unsigned char) *message++, style);
        count++;
    }
    return count;
}

void lcdClear() {
    lcdLocate(0, 0);
    for (uint16_t i = 0; i < ((uint16_t)LCD_WIDTH * LCD_PAGES); i++) {
        LCD_write_byte(0, 1);
    }
}
